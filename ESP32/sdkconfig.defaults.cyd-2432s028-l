## ESP32S3/main/Kconfig.projbuild
```kconfig
menu "CYM Board Selection (ESP32-S3)"

    choice BOARD_S3_SELECT
        prompt "ESP32-S3 board variant"
        default BOARD_HOSYOND_S3_35

        config BOARD_HOSYOND_S3_35
            bool "Hosyond 3.5\" ES3C35P (ST77922 QSPI, 320x480)"

        config BOARD_HOSYOND_S3_28
            bool "Hosyond 2.8\" (ILI9341V SPI, 240x320) — pending GPIO confirm"

    endchoice

endmenu
```

## ESP32S3/sdkconfig.defaults.ws-s3-5b
```kconfig
# Waveshare 5B 1024x600 RGB, NOT the 800x480 model.
CONFIG_BOARD_WS_S3_5B=y
CONFIG_ESPTOOLPY_FLASHSIZE_16MB=y
CONFIG_ESPTOOLPY_FLASHSIZE="16MB"
CONFIG_SPIRAM_MODE_OCT=y
CONFIG_SPIRAM_SPEED_80M=y
CONFIG_ESP_DEFAULT_CPU_FREQ_MHZ_240=y
CONFIG_LV_COLOR_16_SWAP=n
CONFIG_LCD_RGB_ISR_IRAM_SAFE=y
CONFIG_LCD_RGB_RESTART_IN_VSYNC=y
CONFIG_SPIRAM_XIP_FROM_PSRAM=y
CONFIG_SPIRAM_FETCH_INSTRUCTIONS=y
CONFIG_SPIRAM_RODATA=y
CONFIG_ESP_CONSOLE_USB_SERIAL_JTAG=y
CONFIG_ESP_CONSOLE_SECONDARY_NONE=y
CONFIG_ESP_CONSOLE_UART_DEFAULT=n
```

## tools/ClassicCYDgpsTest/sdkconfig.defaults
```kconfig
# Classic CYD dual-USB diagnostic: 4 MB ESP32, no console traffic on UART pins.
CONFIG_ESPTOOLPY_FLASHSIZE_4MB=y
CONFIG_ESPTOOLPY_FLASHSIZE="4MB"
CONFIG_ESPTOOLPY_FLASHMODE_DIO=y
CONFIG_ESPTOOLPY_FLASHFREQ_40M=y
CONFIG_PARTITION_TABLE_CUSTOM=y
CONFIG_PARTITION_TABLE_CUSTOM_FILENAME="partitions.csv"
CONFIG_PARTITION_TABLE_OFFSET=0x8000
CONFIG_ESP_CONSOLE_NONE=y
# CONFIG_ESP_CONSOLE_UART_DEFAULT is not set
CONFIG_BOOTLOADER_LOG_LEVEL_NONE=y
# CONFIG_BOOTLOADER_LOG_LEVEL_INFO is not set
CONFIG_LOG_DEFAULT_LEVEL_NONE=y
CONFIG_COMPILER_OPTIMIZATION_SIZE=y
CONFIG_ESP_MAIN_TASK_STACK_SIZE=8192
```

## tools/WS28AudioDiag/sdkconfig.defaults
```kconfig
CONFIG_IDF_TARGET="esp32c5"
CONFIG_ESPTOOLPY_FLASHSIZE_32MB=y
CONFIG_ESPTOOLPY_FLASHSIZE="32MB"
CONFIG_ESPTOOLPY_FLASHMODE_DIO=y
CONFIG_ESPTOOLPY_FLASHFREQ_80M=y
CONFIG_PARTITION_TABLE_CUSTOM=y
CONFIG_PARTITION_TABLE_CUSTOM_FILENAME="partitions.csv"
CONFIG_PARTITION_TABLE_OFFSET=0x8000
CONFIG_ESP_CONSOLE_USB_SERIAL_JTAG=y
CONFIG_ESP_CONSOLE_SECONDARY_NONE=y
CONFIG_VFS_SUPPORT_IO=y
CONFIG_BOOTLOADER_LOG_LEVEL_INFO=y
CONFIG_CODEC_ES8311_SUPPORT=y
# CONFIG_CODEC_I2C_BACKWARD_COMPATIBLE is not set
CONFIG_FREERTOS_HZ=1000
```
